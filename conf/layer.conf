## conf/layer.conf
```bitbake
# We have a conf and classes directory, add to BBPATH
BBPATH .= ":${LAYERDIR}"

# We have a recipes-* directories, add to BBFILES
BBFILES += "${LAYERDIR}/recipes-*/*/*.bb \
	${LAYERDIR}/recipes-*/*/*.bbappend"

BBFILE_COLLECTIONS += "actions"
BBFILE_PATTERN_actions = "^${LAYERDIR}/"
BBFILE_PRIORITY_actions = "6"

# Set a variable to get to the top of the meta-layer location
HAB_BASE := '${LAYERDIR}'
```

## conf/machine/bubblegum96.conf
```bitbake
#@TYPE: Machine
#@NAME: uCRobotics Bubblegum machine
#@DESCRIPTION: uCRobotics Bubblegum machine

MACHINEOVERRIDES = "actions:${MACHINE}"

require conf/machine/include/arm/arch-armv8.inc
include conf/machine/include/actions-base.inc

SERIAL_CONSOLE ?= "115200 ttyS5"

PREFERRED_PROVIDER_virtual/bootloader = "u-boot-bubblegum96"
PREFERRED_PROVIDER_u-boot = "u-boot-bubblegum96"
PREFERRED_VERSION_virtual/bootloader = "2015.07"

UBOOT_MACHINE = "s900_96board_defconfig"
UBOOT_NAME = "u-boot-dtb"
UBOOT_SUFFIX = "img"
UBOOT_BINARY = "${UBOOT_NAME}.${UBOOT_SUFFIX}"
UBOOT_ENTRYPOINT = "0x11000000"
UBOOT_LOADADDRESS = "0x11000000"

PREFERRED_PROVIDER_virtual/kernel = "linux-bubblegum96"

KERNEL_DEVICETREE = "s900_96board.dtb"
KERNEL_IMAGETYPE = "Image"
KERNEL_BOOTCMD = "booti"

CMDLINE_ROOT_EMMC   = "mmcblk0p2"
CMDLINE_ROOT_SDCARD = "mmcblk1p2"
CMDLINE ?= "console=ttyS5,115200n8 root=/dev/${CMDLINE_ROOT_EMMC} rootwait rw quiet"

IMAGE_FSTYPES ?= "tar.bz2 ext4.gz wic.xz"
IMAGE_ROOTFS_ALIGNMENT = "4096"
IMAGE_BOOT_FILES = "Image s900_96board.dtb;kernel.dtb"

do_image_wic[depends] += "u-boot-bubblegum96:do_deploy"
WKS_FILE ?= "bubblegum96.wks"
```

## conf/machine/cubieboard7.conf
```bitbake
MACHINEOVERRIDES = "actions:${MACHINE}"

require conf/machine/include/arm/arch-armv8.inc
include conf/machine/include/actions-base.inc

SERIAL_CONSOLE ?= "115200 ttyS3"

PREFERRED_PROVIDER_virtual/bootloader = "u-boot"
PREFERRED_PROVIDER_u-boot = "u-boot"
PREFERRED_VERSION_virtual/bootloader = "git"

UBOOT_MACHINE = "s700_cb7_linux_defconfig"
UBOOT_NAME = "u-boot-dtb"
UBOOT_SUFFIX = "img"
UBOOT_BINARY = "${UBOOT_NAME}.${UBOOT_SUFFIX}"
UBOOT_ENTRYPOINT = "0x11000000"
UBOOT_LOADADDRESS = "0x11000000"

PREFERRED_PROVIDER_virtual/kernel = "linux-actions"

KERNEL_DEVICETREE = "s700_cb7_linux.dtb"
KERNEL_IMAGETYPE = "Image"
KERNEL_BOOTCMD = "booti"

CMDLINE_ROOT_EMMC   = "mmcblk0p2"
CMDLINE_ROOT_SDCARD = "mmcblk1p2"
CMDLINE ?= "console=ttyS3,115200n8 root=/dev/${CMDLINE_ROOT_EMMC} rootwait rw quiet"

IMAGE_FSTYPES ?= "tar.bz2 ext4.gz wic.xz"
IMAGE_ROOTFS_ALIGNMENT = "4096"
IMAGE_BOOT_FILES = "Image s700_cb7_linux.dtb;kernel.dtb"

do_image_wic[depends] += "u-boot:do_deploy"
WKS_FILE ?= "cubieboard7.wks"
```

## recipes-kernel/linux/linux-mainline/defconfig
```kconfig
CONFIG_ARCH_ACTIONS=y
# CONFIG_DEBUG_ALIGN_RODATA is not set
CONFIG_SMP=y
CONFIG_HZ_250=y
CONFIG_EFI=y
CONFIG_ECHO=y
# CONFIG_DEVMEM is not set
CONFIG_SERIAL_OWL=y
CONFIG_POWER_RESET=y
CONFIG_POWER_SUPPLY=y
CONFIG_WATCHDOG=y
CONFIG_OWL_PM_DOMAINS=y
CONFIG_TEE=y
CONFIG_FRAME_WARN=2048
```

## wic/bubblegum96.wks
```
#####################
# description: Create an image that can be written into an eMMC using dd
#
# The disk layout used is:
# ---------------------------------------------------
# |	| bootloader.bin | u-boot | /boot | /rootfs |
# ---------------------------------------------------
#	^		 ^
#	|		 |
# 0	2048kiB		 3072kiB
#
# Offset which bubblegum96 really looks for,
# bootloader.bin - 4097 Bytes
# u-boot	 - 3072 kiB
#
# bootloader.bin is delivered as binary from vendor which is directly copied into
# recipes-bsp/u-boot.
#
# As wic align doesn't support alignment in bytes, bootloader.bin is prepended with
# 512 bytes of zeros and copied into 2048kiB (4096 bytes offset).

part bootloader --no-table --align 2048 --source rawcopy --sourceparams="file=bootloader.bin"
part u-boot --no-table --align 3072 --source rawcopy --sourceparams="file=u-boot-dtb.img"
part /boot --source bootimg-partition --ondisk mmcblk1 --fstype=vfat --label boot --active --size 20
part / --source rootfs --ondisk mmcblk1 --fstype=ext4 --label root
```

## wic/cubieboard7.wks
```
#####################
# short-description: Create eMMC & SD image
# long-description: Create an image that can be written into an eMMC & SD using dd
#
# The disk layout used is:
# ---------------------------------------------------
# |	| bootloader.bin | u-boot | /boot | /rootfs |
# ---------------------------------------------------
#	^		 ^
#	|		 |
# 0	2048kiB		 3072kiB

part bootloader --no-table --align 2048 --source rawcopy --sourceparams="file=bootloader.bin"
part u-boot --no-table --align 3072 --source rawcopy --sourceparams="file=u-boot-dtb.img"
part /boot --source bootimg-partition --ondisk mmcblk1 --fstype=vfat --label boot --active --size 20
part / --source rootfs --ondisk mmcblk1 --fstype=ext4 --label root
```
